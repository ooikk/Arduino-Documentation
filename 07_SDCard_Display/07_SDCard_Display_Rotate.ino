// Define the SD Chip Select pin (must match wiring)
#define VSPI_PIN  // SD card is using VSPI and TFT is using HSPI

#include <SPI.h>
#include <SD.h>
//#include "SdFat.h"
#include <TFT_eSPI.h>


#ifdef VSPI_PIN
#define SD_SCLK_PIN 4
#define SD_MISO_PIN 5
#define SD_MOSI_PIN 6
#else
#define SD_SCLK_PIN 12
#define SD_MISO_PIN 13
#define SD_MOSI_PIN 11
#endif

#define SD_CS_PIN 7
#define SD_FREQUENCY 16000000  // 16MHz or 4MHz

TFT_eSPI tft = TFT_eSPI();

#ifdef VSPI_PIN
SPIClass sdSPI(VSPI);
#else
SPIClass sdSPI(HSPI);
#endif

//#define ARROW_SPRITE

#ifdef ARROW_SPRITE

TFT_eSprite arrowSprite = TFT_eSprite(&tft);  // Create a sprite

// A 16x16 pixel arrow icon (RGB565 16-bit color format)
// Background is black (0x0000), Arrow is Cyan (0x07FF)
const uint16_t arrowIcon[256] PROGMEM = {
  0, 0, 0, 0, 0, 0, 0, 0x07FF, 0x07FF, 0, 0, 0, 0, 0, 0, 0,
  0, 0, 0, 0, 0, 0, 0, 0x07FF, 0x07FF, 0, 0, 0, 0, 0, 0, 0,
  0, 0, 0, 0, 0, 0, 0x07FF, 0x07FF, 0, 0, 0, 0, 0, 0, 0,
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  0, 0, 0, 0, 0, 0, 0, 0, 0, 0, 0, 0, 0, 0, 0, 0
};

int angle = 0;  // Tracks rotation angle (0 to 360 degrees)

#else

// Create an instance of the sprite class for flickering-free smooth rotation
//TFT_eSprite* needleSprite = nullptr;  // Will hold the scaled needle

TFT_eSprite blackScreen = TFT_eSprite(&tft);
TFT_eSprite needle(&tft);

int angle = 0;
int angle_inc = 30;
int dstW, dstH, pivotX, pivotY;
// ---------- User Settings ----------
#define SCALE_FACTOR 0.5f   // Must be < 1 to downscale
#define NEEDLE_CENTERX 14   // Original pivot X (from top-left)
#define NEEDLE_CENTERY 172  // Original pivot Y (from top-left)
#define CLOCKHAND_WIDTH 28
#define CLOCKHAND_HEIGHT 185

// Display pivot (where the needle rotates around on screen)
#define SCREEN_PIVOT_X 100  // Example: center of a 320x240 screen
#define SCREEN_PIVOT_Y 100

// array size is 10360
static const uint16_t clockhand[] PROGMEM = {
  0x0000, 0x0000, 0x0000, 0x0000, 0x0000, 0x0000, 0x0000, 0x0000, 0x0000, 0x0000, 0x0000, 0x0000, 0x0000, 0x0000, 0x0000, 0x0000, 0x0000, 0x0000, 0x0000, 0x0000, 0x0000, 0x0000, 0x0000, 0x0000, 0x0000, 0x0000, 0x0000, 0x0000,
  0x0000, 0x0000, 0x0000, 0x0000, 0x0000, 0x0000, 0x0000, 0x0000, 0x0000, 0x0000, 0x0000, 0x0000, 0x0000, 0x0000, 0x0000, 0x0000, 0x0000, 0x0000, 0x0000, 0x0000, 0x0000, 0x0000, 0x0000, 0x0000, 0x0000, 0x0000, 0x0000, 0x0000,
  0x0000, 0x0000, 0x0000, 0x0000, 0x0000, 0x0000, 0x0000, 0x0000, 0x0000, 0x0000, 0x0000, 0x0000, 0x0000, 0x0000, 0x0000, 0x0000, 0x0000, 0x0000, 0x0000, 0x0000, 0x0000, 0x0000, 0x0000, 0x0000, 0x0000, 0x0000, 0x0000, 0x0000,
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  0x0000, 0x0000, 0x0000, 0x0000, 0x0000, 0x0000, 0x0000, 0x0000, 0x0000, 0x0000, 0x0000, 0x0000, 0x0000, 0x0000, 0x0000, 0x0000, 0x0000, 0x0000, 0x0000, 0x0000, 0x0000, 0x0000, 0x0000, 0x0000, 0x0000, 0x0000, 0x0000, 0x0000

};


// ---------- Function: Scale the needle into a sprite ----------
//void scaleClockHand(TFT_eSprite* needle, float scale) {
void scaleClockHand(TFT_eSprite* mySprite) {
  // Nearest‑neighbour scaling (copy pixels)
  for (int y = 0; y < dstH; y++) {
    for (int x = 0; x < dstW; x++) {
      int srcX = (x * CLOCKHAND_WIDTH) / dstW;
      int srcY = (y * CLOCKHAND_HEIGHT) / dstH;
      uint16_t color = pgm_read_word(&clockhand[srcY * CLOCKHAND_WIDTH + srcX]);
      mySprite->drawPixel(x, y, color);
    }
  }
  //needle.fillCircle(0,0,5,TFT_RED);

  return;
}


#endif

void setup() {
  Serial.begin(115200);
  delay(1000);



  // Initialize TFT Display
  Serial.println("Initializing TFT...");
  tft.init();
  tft.setRotation(1);
  tft.fillScreen(TFT_BLACK);
  tft.setTextColor(TFT_WHITE, TFT_BLACK);
  tft.setTextSize(2);
  tft.setCursor(0, 0);

  Serial.println("TFT ready...");
  // tft.println("TFT ready...");

  // Explicitly bind SPI to your SPI pins BEFORE SD.begin()
  // SPI.begin(SD_SCLK_PIN, SD_MISO_PIN, SD_MOSI_PIN);
  sdSPI.begin(SD_SCLK_PIN, SD_MISO_PIN, SD_MOSI_PIN);  // SCK, MISO, MOSI

  Serial.println("Initializing SD card...");
  //if (!SD.begin(SD_CS_PIN, SPI, SD_FREQUENCY)) {
  if (!SD.begin(SD_CS_PIN, sdSPI, SD_FREQUENCY)) {
    Serial.println("SD Card initialization failed! Try again...");
    if (!SD.begin(SD_CS_PIN, sdSPI, SD_FREQUENCY)) {
      while (1) delay(1000);  // Halt
    }
  }

  Serial.println("SD Card initialized successfully.");

  uint64_t cardSize = SD.cardSize() / (1024 * 1024);
  Serial.printf("SD Card Size: %lluMB\n", cardSize);

  //tft.setSwapBytes(true);

#ifdef ARROW_SPRITE

  // 1. Create a 32x32 sprite (larger than the icon)
  arrowSprite.createSprite(32, 32);

  // 2. Clear the entire 32x32 buffer to BLACK
  arrowSprite.fillSprite(TFT_BLACK);

  // 3. Draw the 16x16 arrow in the CENTER of this 32x32 canvas
  //    (Offset = (32-16)/2 = 8)
  arrowSprite.pushImage(8, 8, 16, 16, arrowIcon);

  // 4. Pivot is now at the center of the 32x32 sprite (16, 16)
  arrowSprite.setPivot(16, 16);

  tft.setPivot(120, 120);

  tft.setTextFont(2);
  tft.setTextColor(TFT_WHITE, TFT_BLACK);
  tft.drawString("Rotating Sprite Demo", 10, 10);

#else


  // Compute destination dimensions (round to nearest integer, at least 1)
  dstW = max(1, (int)(CLOCKHAND_WIDTH * SCALE_FACTOR + 0.5f));
  dstH = max(1, (int)(CLOCKHAND_HEIGHT * SCALE_FACTOR + 0.5f));
  // Set the sprite's pivot to the scaled original pivot
  pivotX = (int)(NEEDLE_CENTERX * SCALE_FACTOR + 0.5f);
  pivotY = (int)(NEEDLE_CENTERY * SCALE_FACTOR + 0.5f);


  blackScreen.createSprite(dstH * 2, dstH * 2);
  blackScreen.fillSprite(TFT_BLACK);
  blackScreen.setPivot(dstH, dstH);  // center of black area, pivot for the needle to pin on
  needle.createSprite(dstW, dstH);
  needle.setPivot(pivotX, pivotY);   // draw to blackScreen' dstH and dstW location

  needle.setSwapBytes(true);
  // Create the scaled needle sprite
  scaleClockHand(&needle);

  // Draw static text (will be redrawn each loop)
  tft.setTextFont(2);
  tft.setTextColor(TFT_WHITE, TFT_BLACK);
  tft.drawString("Rotating Needle", 10, 10);
#endif
}

void loop() {

#ifdef ARROW_SPRITE

  // 5. Push the rotated sprite, but use a "fake" transparency key!
  //    Since the sprite only has BLACK and CYAN, using TFT_RED as the key
  //    means NO pixels are skipped. The black background will overwrite the screen.
  arrowSprite.pushRotated(angle, TFT_RED);  //RED);

  angle++;
  if (angle >= 360) angle = 0;
  delay(15);

#else

  // Clear the whole screen (removes any ghost)
  blackScreen.fillSprite(TFT_WHITE); //
  // scale the image
  scaleClockHand(&needle);

  // Push the rotated needle to blackScreen sprite memory
  needle.pushRotated(&blackScreen, angle, TFT_BLACK);  // TFT_BLACK image is black background
  // Push the sprite to tft
  blackScreen.pushSprite(SCREEN_PIVOT_X, SCREEN_PIVOT_Y);

  // 4. Update angle for next frame
  angle = (angle + angle_inc);  // % 360;
  if (angle >= 360) {
    angle = 0;
    if (angle_inc == 1) angle_inc = 30;
    else angle_inc = 1;
  }

  delay(15);  // Adjust speed

#endif
}
