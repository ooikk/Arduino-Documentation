#include <SPI.h>
#include <SD.h>
#include <TFT_eSPI.h>

// Define the SD Chip Select pin (must match wiring)
#define VSPI_PIN  // SD card is using VSPI and TFT is using HSPI

#ifdef VSPI_PIN
#define SD_SCLK_PIN 4
#define SD_MISO_PIN 5
#define SD_MOSI_PIN 6
#else
#define SD_SCLK_PIN 12
#define SD_MISO_PIN 13
#define SD_MOSI_PIN 11
#endif

#define SD_CS_PIN 7
#define SD_FREQUENCY 16000000  // 24000000 16000000 4000000


//#define SMALLER_IMAGE
#define SCR_WIDTH 200
#define SCR_HEIGHT 150
#define SCR_OFFSET_X 20
#define SCR_OFFSET_Y 30

TFT_eSPI tft = TFT_eSPI();


// 1️⃣ Define SPI class for SD
#ifdef VSPI_PIN
SPIClass sdSPI(VSPI);
#else
SPIClass sdSPI(HSPI);
#endif


// [BEGIN lopaka generated]
//#include "Org_01.h"
//#include "Petme8x8.h"

static const unsigned char PROGMEM image_cloud_bits[] = { 0x00, 0x00, 0x0f, 0xf0, 0x00, 0x00, 0x00, 0x00, 0x00, 0x00, 0x00, 0x00, 0x0f,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 0x00, 0x00 };
static const unsigned char PROGMEM image_cloud_copy_1_bits[] = { 0x06, 0x00, 0x00, 0x1f, 0x80, 0x00, 0x3f, 0xf0, 0x00, 0x3f, 0xf8, 0x00, 0x7f, 0xfc, 0x00, 0xff, 0xfe, 0x00, 0xff, 0xff, 0x00, 0xff, 0xff, 0x00, 0xff, 0xfe, 0x00, 0x7f, 0xfc, 0x00 };
static const unsigned char PROGMEM image_cloudy_day_bits[] = { 0x00, 0x00, 0x00, 0x00, 0x00, 0x00, 0x18, 0x00, 0x00, 0x00, 0x18, 0x00, 0x00,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 0x00, 0x00 };
static const unsigned char PROGMEM image_cloudy_day_copy_2_bits[] = { 0x00, 0x40, 0x00, 0x40, 0x02, 0x0c, 0x01, 0xf0, 0x01, 0xf8, 0x01, 0xfb, 0x0c, 0xf8, 0x1f, 0x38, 0x3f, 0xd8, 0x3f, 0xe4, 0xff, 0xe0, 0xff, 0xf8, 0xff, 0xf8, 0xff, 0xf8, 0xff, 0xf8, 0x00, 0x00 };
static const unsigned char PROGMEM image_display_brightness_bits[] = { 0x00, 0x03, 0x00, 0x00, 0x00, 0x03, 0x00, 0x00, 0x0c, 0x03, 0x00, 0xc0, 0x0c,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 0x00, 0x00 };
static const unsigned char PROGMEM image_display_brightness_copy_1_bits[] = { 0x01, 0x00, 0x21, 0x08, 0x10, 0x10, 0x03, 0x80, 0x8c, 0x62, 0x48, 0x24, 0x10, 0x10, 0x10, 0x10, 0x10, 0x10, 0x48, 0x24, 0x8c, 0x62, 0x03, 0x80, 0x10, 0x10, 0x21, 0x08, 0x01, 0x00, 0x00, 0x00 };
static const unsigned char PROGMEM image_weather_cloud_rain_bits[] = { 0x00, 0x00, 0x00, 0x00, 0x00, 0x00, 0x00, 0x00, 0x00, 0x00, 0x00, 0x3f, 0xf0,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 0x00, 0x00 };

int line_4_color = 0x4208;
int rect_1_radius = 8;
int rect_27_radius = 5;
void drawWeather(void) {
  tft.fillScreen(0x0);
  // rect 1
  tft.fillRoundRect(10, 2, 300, 230, rect_1_radius, 0x187);
  // rect 27
  tft.fillRoundRect(18, 9, 287, 62, rect_27_radius, 0x495);
  // rect 28
  tft.fillRoundRect(18, 82, 135, 145, 5, 0x495);
  // rect 28 copy 1
  tft.fillRoundRect(165, 82, 140, 145, 5, 0x495);
  // string 2
  tft.setTextColor(0xFFFF);
  tft.setTextSize(4);
  tft.setTextWrap(false);
  tft.setFreeFont(NULL);  //&FreeSans9pt7b);  //kk
  tft.setCursor(80, 40);
  tft.print("19:49:18");
  // string 2 copy 1
  tft.setTextSize(1);
  tft.setFreeFont(&FreeSans9pt7b);  //kk
  tft.setCursor(80, 29);
  tft.print("Singapore, 30 Mei 2026");
  // line 4
  tft.drawLine(18, 77, 301, 78, line_4_color);
  // line 5
  tft.drawLine(24, 76, 298, 76, 0xFFFF);
  // line 6
  tft.drawLine(159, 83, 159, 225, 0xFFFF);
  // string 2 copy 2
  tft.setCursor(57, 101);
  tft.print("Tampines");
  // cloud
  tft.drawBitmap(23, 113, image_cloud_bits, 77, 38, 0xFFFF);  
  // string 2 copy 3
  tft.setTextSize(2);
  tft.setCursor(94, 152);
  tft.print("31");
  // string 2 copy 4
  tft.setTextSize(1);
  tft.setCursor(142, 150);
  tft.print("C");
  // string 2 copy 5
  tft.setCursor(117, 174);
  tft.print("45%");
  // string 2 copy 6
  tft.setCursor(30, 174);
  tft.print("22km/h");
  // string 2 copy 7
  tft.setCursor(178, 96);
  tft.print("MON");
  // string 2 copy 8
  tft.setCursor(178, 110);
  tft.print("24-26");
  // cloudy_day
  tft.drawBitmap(180, 118, image_cloudy_day_bits, 32, 32, 0xFFFF);  
  // string 2 copy 9
  tft.setCursor(248, 96);
  tft.print("TUE");
  // string 2 copy 10
  tft.setCursor(251, 110);
  tft.print("20-24");
  // string 2 copy 11
  tft.setCursor(178, 166);
  tft.print("WED");
  // display_brightness
  tft.drawBitmap(256, 118, image_display_brightness_bits, 30, 32, 0xFEA0);  
  // string 2 copy 12
  tft.setCursor(178, 180);
  tft.print("24-26");
  // cloudy_day copy 1
  tft.drawBitmap(180, 188, image_weather_cloud_rain_bits, 32, 32, 0xFFFF);  
  // string 2 copy 13
  tft.setCursor(255, 166);
  tft.print("THU");
  // string 2 copy 14
  tft.setCursor(251, 180);
  tft.print("24-26");
  // string 2 copy 15
  tft.setFreeFont(NULL);  //kk
  //tft.setCursor(23, 180);
  //tft.print("09:00");
  // weather_cloud_rain
  tft.drawBitmap(256, 188, image_weather_cloud_rain_bits, 34, 32, 0xFFFF);
  // cloudy_day copy 2
  tft.drawBitmap(27, 202, image_cloudy_day_copy_2_bits, 16, 16, 0xFFFF);  
  // string 2 copy 16
  tft.setCursor(23, 190);
  tft.print("09:00");
  // string 2 copy 17
  tft.setCursor(56, 190);
  tft.print("10:00");
  // string 2 copy 18
  tft.setCursor(84, 190);
  tft.print("11:00");
  // display_brightness copy 1
  tft.drawBitmap(58, 202, image_display_brightness_copy_1_bits, 15, 16, 0xFEA0);
  // cloud copy 1
  tft.drawBitmap(84, 204, image_cloud_copy_1_bits, 19, 10, 0xFFFF);  
  //tft.drawBitmap(84, 204, image_weather_cloud_rain_bits, 19, 10, 0xFFFF);
  // string 2 copy 19
  tft.setCursor(110, 190);
  tft.print("12:00");
  // cloud copy 2
  tft.setCursor(10, 250);
  tft.setTextColor(TFT_YELLOW,TFT_BLACK);
  tft.setTextSize(2);
  tft.println("Display all weather icons");
  tft.drawBitmap(10, 300, image_cloud_bits, 77, 38, 0xFFFF);
  tft.drawBitmap(100, 300, image_cloudy_day_bits, 32, 32, 0xFFFF);
  tft.drawBitmap(160, 300, image_display_brightness_bits, 30, 32, 0xFFFF);
  tft.drawBitmap(210, 300, image_weather_cloud_rain_bits, 32, 32, 0xFFFF);
  tft.drawBitmap(10, 350, image_cloud_copy_1_bits, 19, 10, 0xFFFF);
  tft.drawBitmap(40, 350, image_cloudy_day_copy_2_bits, 16, 16, 0xFFFF);
  tft.drawBitmap(70, 350, image_display_brightness_copy_1_bits, 15, 16, 0xFFFF);
}
// [END lopaka generated]




void setup() {
  Serial.begin(115200);
  delay(500);

  // 1️⃣ Set all CS pins high to deselect devices before initialization
  pinMode(TFT_CS, OUTPUT);
  digitalWrite(TFT_CS, HIGH);
  pinMode(TOUCH_CS, OUTPUT);
  digitalWrite(TOUCH_CS, HIGH);
  pinMode(SD_CS_PIN, OUTPUT);
  digitalWrite(SD_CS_PIN, HIGH);
  delay(100);

  // 2️⃣ Initialize the TFT first. This also sets up the SPI bus
  //  (HSPI or VSPI, because of USE_HSPI_PORT or USE_FSPI_PORT in User_Setup.h)
  Serial.println("Initializing TFT...");
  tft.init();
  tft.setRotation(2);
  tft.fillScreen(TFT_BLACK);
  tft.setTextColor(TFT_WHITE, TFT_BLACK);
  tft.setTextSize(2);
  tft.setCursor(0, 0);

  // 3️⃣ Get the SPI bus instance that the TFT is using
  // SPIClass& sdSPI = tft.getSPIinstance();

  // 3️⃣ Explicitly bind SPI to your SPI pins BEFORE SD.begin()
  // SPI.begin(SD_SCLK_PIN, SD_MISO_PIN, SD_MOSI_PIN);
  sdSPI.begin(SD_SCLK_PIN, SD_MISO_PIN, SD_MOSI_PIN);  // SCK, MISO, MOSI

  // 4️⃣ Now initialize the SD card on the SPI bus
  Serial.println("Initializing SD card...");
  if (!SD.begin(SD_CS_PIN, sdSPI, SD_FREQUENCY)) {
    Serial.println("SD Card initialization failed! Try again...");
    delay(1000);
    if (!SD.begin(SD_CS_PIN, sdSPI, SD_FREQUENCY)) {
      Serial.println("SD Card initialization failed!");
      tft.println("SD Card init failed!");
      while (1) delay(1000);
    }
  }
  tft.println("SD Card init completed!");

  Serial.printf("Free heap before open: %u\n", ESP.getFreeHeap());


  // ****************** Get card information
  // Get the card object and check read-only
  uint8_t cardType = SD.cardType();
  uint64_t cardSize = SD.cardSize();
  //bool isReadOnly = SD.card()->readOnly();  // may not be available in all versions


  if (cardType == CARD_MMC) {
    Serial.println("Card type: MMC");
  } else if (cardType == CARD_SD) {
    Serial.println("Card type: SDSC");
  } else if (cardType == CARD_SDHC) {
    Serial.println("Card type: SDHC");
  } else {
    Serial.println("Unknown card type");
  }

  Serial.printf("Card type: %d, Size: %llu MB\n", cardType, cardSize / (1024 * 1024));
  //Serial.printf("Read-only status: %s\n", isReadOnly ? "Yes" : "No");

  tft.fillScreen(TFT_BLACK);
  Serial.println("Start draw weather");
  drawWeather();
  tft.drawBitmap(110, 204, image_cloud_copy_1_bits, 19, 10, 0xFFFF);


  Serial.println("Complete draw weather");
  //waitForSerial();
}

void loop() {
}


void waitForSerial() {

  // Clear the serial buffer so it doesn't instantly loop again
  while (Serial.available())
    Serial.read();
  Serial.println("Press <SEND> (or type a character) to advance");
  // Wait here until a character is received over Serial
  while (!Serial.available())
    ;
}
