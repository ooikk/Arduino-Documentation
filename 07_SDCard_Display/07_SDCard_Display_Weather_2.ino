#include <SPI.h>
#include <SD.h>
#include <TFT_eSPI.h>

// Define the SD Chip Select pin (must match wiring)
#define VSPI_PIN  // SD card is using VSPI and TFT is using HSPI

#ifdef VSPI_PIN
#define SD_SCLK_PIN 4
#define SD_MISO_PIN 5
#define SD_MOSI_PIN 6
#else
#define SD_SCLK_PIN 12
#define SD_MISO_PIN 13
#define SD_MOSI_PIN 11
#endif

#define SD_CS_PIN 7
#define SD_FREQUENCY 16000000  // 24000000 16000000 4000000


//#define SMALLER_IMAGE
#define SCR_WIDTH 200
#define SCR_HEIGHT 150
#define SCR_OFFSET_X 20
#define SCR_OFFSET_Y 30

TFT_eSPI tft = TFT_eSPI();


// 1️⃣ Define SPI class for SD
#ifdef VSPI_PIN
SPIClass sdSPI(VSPI);
#else
SPIClass sdSPI(HSPI);
#endif

static const uint16_t PROGMEM image_w_crowd_pixels[] = { 0xFFFF, 0xFFFF, 0xFFFF, 0xFFFF, 0xFFFF, 0xFFFF, 0xFFFF, 0xFFFF, 0xFFFF, 0xFFFF, 0xFFFF, 0xFFFF, 0xFFFF,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 0xFFFF, 0xFFFF };
static const uint16_t PROGMEM image_w_rain_pixels[] = { 0xFFFF, 0xFFFF, 0xFFFF, 0xFFFF, 0xFFFF, 0xFFFF, 0xFFFF, 0xFFFF, 0xFFFF, 0xFFFF, 0xFFFF, 0xFFFF, 0xFFFF,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 0xFFFF, 0xFFFF };
static const uint16_t PROGMEM image_w_sun_crowd_pixels[] = { 0xFFFF, 0xFFFF, 0xFFFF, 0xFFFF, 0xFFFF, 0xFFFF, 0xFFFF, 0xFFFF, 0xFFFF, 0xFFFF, 0xFFFF, 0xFFFF, 0xFFFF,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 0xFFFF, 0xFFFF };
static const uint16_t PROGMEM image_W_sunny_pixels[] = { 0xFFFF, 0xFFFF, 0xFFFF, 0xFFFF, 0xFFFF, 0xFFFF, 0xFFFF, 0xFFFF, 0xFFFF, 0xFFFF, 0xFFFF, 0xFFFF, 0xFFFF,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 0xFFFF, 0xFFFF };
static const uint16_t PROGMEM image_w_thunder_pixels[] = { 0xFFFF, 0xFFFF, 0xFFFF, 0xFFFF, 0xFFFF, 0xFFFF, 0xFFFF, 0xFFFF, 0xFFFF, 0xFFFF, 0xFFFF, 0xFFFF, 0xFFFF,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 0xFFFF, 0xFFFF };
static const unsigned char PROGMEM image_weather_cloud_lightning_bolt_bits[] = { 0x00, 0x00, 0x00, 0x00, 0x00, 0x00, 0x00, 0x00, 0x00, 0x00, 0x00, 0x00, 0x00,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 0x00, 0x00 };
static const unsigned char PROGMEM image_weather_cloud_rain_bits[] = { 0x00, 0x00, 0x00, 0x00, 0x00, 0x00, 0x00, 0x00, 0x00, 0x00, 0x00, 0x00, 0x00,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 0x00, 0x00 };
static const unsigned char PROGMEM image_weather_cloud_snow_bits[] = { 0x00, 0x00, 0x00, 0x00, 0x00, 0x00, 0x00, 0x00, 0x00, 0x00, 0x00, 0x00, 0x00,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 0x00, 0x00 };
static const unsigned char PROGMEM image_weather_cloud_sunny_bits[] = { 0x00, 0x00, 0x00, 0x03, 0x80, 0x00, 0x00, 0x00, 0x00, 0x00, 0x03, 0x80, 0x00,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 0xf8, 0x00 };
static const unsigned char PROGMEM image_weather_sun_bits[] = { 0x00, 0x00, 0x07, 0x00, 0x00, 0x00, 0x00, 0x00, 0x07, 0x00, 0x00, 0x00, 0x00,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 0x00, 0x00 };

void drawScreen_1(void) {
  tft.fillScreen(0x0);
  // string 2
  tft.setTextColor(0xfe00);
  tft.setTextSize(2);
  tft.setRotation(1);
  //tft.fillScreen(TFT_WHITE);
  //tft.setTextWrap(true);
  //tft.setFreeFont(&FreeMono9pt7b);
  //tft.drawString("Weather Icons", 104, 22);
  tft.drawCentreString("Weather Icons", 240, 22, 4);
  // weather_cloud_lightning_bolt
  tft.drawBitmap(59, 86, image_weather_cloud_lightning_bolt_bits, 51, 48, 0xFFFF);
  // weather_cloud_rain
  tft.drawBitmap(140, 86, image_weather_cloud_rain_bits, 51, 48, 0xFFFF);
  // weather_cloud_snow
  tft.drawBitmap(218, 86, image_weather_cloud_snow_bits, 51, 48, 0xFFFF);
  // weather_cloud_sunny
  tft.drawBitmap(287, 86, image_weather_cloud_sunny_bits, 51, 48, 0xFFFF);
  // weather_sun
  tft.drawBitmap(364, 86, image_weather_sun_bits, 45, 48, 0xFFFF);

  // W_sunny
  tft.pushImage(362, 162, 52, 49, image_W_sunny_pixels);
  // w_sun_crowd
  tft.pushImage(284, 161, 52, 49, image_w_sun_crowd_pixels);
  // w_crowd
  tft.pushImage(209, 163, 52, 47, image_w_crowd_pixels);
  // w_rain
  tft.pushImage(142, 163, 52, 46, image_w_rain_pixels);
  // w_thunder
  tft.pushImage(64, 163, 52, 45, image_w_thunder_pixels);

  // W_sunny
  tft.pushImage(362, 220, 52, 49, image_W_sunny_pixels, TFT_WHITE);
  // w_sun_crowd
  tft.pushImage(284, 220, 52, 49, image_w_sun_crowd_pixels, TFT_WHITE);
  // w_crowd
  tft.pushImage(209, 220, 52, 47, image_w_crowd_pixels, TFT_WHITE);
  // w_rain
  tft.pushImage(142, 220, 52, 46, image_w_rain_pixels, TFT_WHITE);
  // w_thunder
  tft.pushImage(64, 220, 52, 45, image_w_thunder_pixels, TFT_WHITE);
}
// [END lopaka generated]





void setup() {
  Serial.begin(115200);
  delay(500);

  // 1️⃣ Set all CS pins high to deselect devices before initialization
  pinMode(TFT_CS, OUTPUT);
  digitalWrite(TFT_CS, HIGH);
  pinMode(TOUCH_CS, OUTPUT);
  digitalWrite(TOUCH_CS, HIGH);
  pinMode(SD_CS_PIN, OUTPUT);
  digitalWrite(SD_CS_PIN, HIGH);
  delay(100);

  // 2️⃣ Initialize the TFT first. This also sets up the SPI bus
  //  (HSPI or VSPI, because of USE_HSPI_PORT or USE_FSPI_PORT in User_Setup.h)
  Serial.println("Initializing TFT...");
  tft.init();
  tft.setRotation(2);
  tft.fillScreen(TFT_BLACK);
  tft.setTextColor(TFT_WHITE, TFT_BLACK);
  tft.setTextSize(2);
  tft.setCursor(0, 0);

  // 3️⃣ Get the SPI bus instance that the TFT is using
  // SPIClass& sdSPI = tft.getSPIinstance();

  // 3️⃣ Explicitly bind SPI to your SPI pins BEFORE SD.begin()
  // SPI.begin(SD_SCLK_PIN, SD_MISO_PIN, SD_MOSI_PIN);
  sdSPI.begin(SD_SCLK_PIN, SD_MISO_PIN, SD_MOSI_PIN);  // SCK, MISO, MOSI

  // 4️⃣ Now initialize the SD card on the SPI bus
  Serial.println("Initializing SD card...");
  if (!SD.begin(SD_CS_PIN, sdSPI, SD_FREQUENCY)) {
    Serial.println("SD Card initialization failed! Try again...");
    delay(1000);
    if (!SD.begin(SD_CS_PIN, sdSPI, SD_FREQUENCY)) {
      Serial.println("SD Card initialization failed!");
      tft.println("SD Card init failed!");
      while (1) delay(1000);
    }
  }
  tft.println("SD Card init completed!");

  Serial.printf("Free heap before open: %u\n", ESP.getFreeHeap());


  // ****************** Get card information
  // Get the card object and check read-only
  uint8_t cardType = SD.cardType();
  uint64_t cardSize = SD.cardSize();
  //bool isReadOnly = SD.card()->readOnly();  // may not be available in all versions


  if (cardType == CARD_MMC) {
    Serial.println("Card type: MMC");
  } else if (cardType == CARD_SD) {
    Serial.println("Card type: SDSC");
  } else if (cardType == CARD_SDHC) {
    Serial.println("Card type: SDHC");
  } else {
    Serial.println("Unknown card type");
  }

  Serial.printf("Card type: %d, Size: %llu MB\n", cardType, cardSize / (1024 * 1024));
  //Serial.printf("Read-only status: %s\n", isReadOnly ? "Yes" : "No");

  tft.fillScreen(TFT_BLACK);
  Serial.println("Start draw weather");

  drawScreen_1();

  Serial.println("Complete draw weather");
  //waitForSerial();
}

void loop() {
}


void waitForSerial() {

  // Clear the serial buffer so it doesn't instantly loop again
  while (Serial.available())
    Serial.read();
  Serial.println("Press <SEND> (or type a character) to advance");
  // Wait here until a character is received over Serial
  while (!Serial.available())
    ;
}
